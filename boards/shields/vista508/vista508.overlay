/*
 * Copyright (c) 2022 The ZMK Contributors
 *
 * SPDX-License-Identifier: MIT
 */

&nice_view_spi {
    status = "okay";
    vista508: ls0xx@0 {
        compatible = "sharp,ls0xx";
        spi-max-frequency = <1000000>;
        reg = <0>;
        width = <144>;
        height = <168>;
    };
};

/ {
    chosen {
        zephyr,display = &vista508;
    };
};
