## boards/shields/vista508/Kconfig.defconfig
```kconfig
# Copyright (c) 2023 The ZMK Contributors
# SPDX-License-Identifier: MIT

if SHIELD_VISTA508

config LV_Z_VDB_SIZE
    default 100

config LV_DPI_DEF
    default 161

config LV_Z_BITS_PER_PIXEL
    default 1

choice LV_COLOR_DEPTH
    default LV_COLOR_DEPTH_1
endchoice

choice ZMK_DISPLAY_WORK_QUEUE
    default ZMK_DISPLAY_WORK_QUEUE_DEDICATED
endchoice

choice ZMK_DISPLAY_STATUS_SCREEN
    default ZMK_DISPLAY_STATUS_SCREEN_CUSTOM
endchoice

config LV_Z_MEM_POOL_SIZE
    default 4096 if ZMK_DISPLAY_STATUS_SCREEN_CUSTOM

config ZMK_DISPLAY_STATUS_SCREEN_CUSTOM
    select LV_FONT_MONTSERRAT_16
    select LV_USE_IMG
    select LV_USE_CANVAS

config VISTA508_WIDGET_INVERTED
    bool "Invert custom status widget colors"

config VISTA508_MESSAGE_DISPLAY_MS
    int "General Message Display Duration (ms)"
    default 5000

config VISTA508_SETTINGS_LAYER
    int "Layer index of the settings layer, display setting change notifications are shown while it is active"
    default -1

config VISTA508_CHARGE_FULL_PCT
    int "Battery level treated as fully charged"
    range 1 100
    default 95
    help
      Charging is inferred as USB powered and below this level.
      Voltage based state of charge reads high while charging, so 100 may never be reached.

if !ZMK_SPLIT || ZMK_SPLIT_ROLE_CENTRAL

config ZMK_DISPLAY_STATUS_SCREEN_CUSTOM
    select LV_FONT_MONTSERRAT_18
    select LV_USE_ANIMIMG
    select ZMK_WPM

endif # !ZMK_SPLIT || ZMK_SPLIT_ROLE_CENTRAL

config ZMK_DISPLAY_STATUS_SCREEN_BUILT_IN
    select LV_FONT_MONTSERRAT_26

endif # SHIELD_VISTA508
```

## config/west.yml
```yaml
manifest:
  remotes:
    - name: zmkfirmware
      url-base: https://github.com/zmkfirmware
    - name: MickiusMousius
      url-base: https://github.com/MickiusMousius
  projects:
    - name: zmk
      import: app/west.yml
      remote: zmkfirmware
      revision: f9be3ed9c08b35b1b86df24c0f04913f3b5e50f5
      clone-depth: 1
    - name: zmk-ls0xxvcom-driver
      remote: MickiusMousius
      revision: main
      clone-depth: 1
    - name: zmk-patch-batterylevel
      remote: MickiusMousius
      revision: main
      clone-depth: 1
    - name: zmk-patch-ec11
      remote: MickiusMousius
      revision: main
      clone-depth: 1
    - name: zmk-smart-sleep
      remote: MickiusMousius
      revision: main
      clone-depth: 1
    - name: zmk-defaultlayer
      remote: MickiusMousius
      revision: main
      clone-depth: 1
    - name: zmk-ble-passkey
      remote: MickiusMousius
      revision: main
      clone-depth: 1
  self:
    path: config
```

## dts/bindings/behaviors/zmk,behavior-mod-tog.yaml
```yaml
description: Auto-Show Modifiers Toggle
compatible: "zmk,behavior-mod-tog"

include: zero_param.yaml

properties:
  "#binding-cells":
    type: int
    const: 0
```

## dts/bindings/behaviors/zmk,behavior-wpm-tog.yaml
```yaml
description: WPM Widget Mode Toggle
compatible: "zmk,behavior-wpm-tog"

include: zero_param.yaml

properties:
  "#binding-cells":
    type: int
    const: 0
```
