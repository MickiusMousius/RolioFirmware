## boards/shields/rolio/Kconfig.shield
```kconfig
config SHIELD_ROLIO_LEFT
    def_bool $(shields_list_contains,rolio_left)

config SHIELD_ROLIO_RIGHT
    def_bool $(shields_list_contains,rolio_right)
```

## boards/shields/vista508/Kconfig.shield
```kconfig
# Copyright (c) 2022 The ZMK Contributors
# SPDX-License-Identifier: MIT

config SHIELD_VISTA508
    def_bool $(shields_list_contains,vista508)
```

## config/boards/shields/rolio/Kconfig.defconfig
```kconfig
if SHIELD_ROLIO_LEFT

config ZMK_KEYBOARD_NAME
    default "Rolio"

config ZMK_SPLIT_ROLE_CENTRAL
    default y

endif

if SHIELD_ROLIO_LEFT || SHIELD_ROLIO_RIGHT

config ZMK_SPLIT
    default y

endif

if ZMK_BACKLIGHT

config PWM
    default y

config LED_PWM
    default y

endif # ZMK_BACKLIGHT
```
